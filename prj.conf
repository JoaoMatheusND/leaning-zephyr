## CMakeLists.txt
```
cmake_minimum_required(VERSION 3.31)

set(BOARD sltb010a@2)

#set(DTC_OVERLAY_FILE ${CMAKE_CURRENT_SOURCE_DIR}/boards/sltb010a.overlay)


find_package(Zephyr)
project(teste)

target_sources(app PRIVATE src/main.c)
```

## prj.conf
```kconfig
CONFIG_UART_CONSOLE=y
CONFIG_CONSOLE=y
CONFIG_SHELL=y
```

## sltb010a@2.overlay
```dts
&usart0 {
    status = "okay";
    pinctrl-0 = <&usart0_tx_pin &usart0_rx_pin>;
    pinctrl-names = "default";
};

&pinctrl {
    usart0_tx_pin: usart0_tx {
        pinmux = <PB01_USART0_TX>; 
    };

    usart0_rx_pin: usart0_rx {
        pinmux = <PB02_USART0_RX>; 
    };
};
```

## src/main.c
```c
#include <zephyr/kernel.h>
#include <zephyr/device.h>
#include <zephyr/drivers/gpio.h>
#include <zephyr/drivers/i2c.h>

#define SENSOR_POWER_GPIO_NODE DT_NODELABEL(gpioa) // Pino PA04
#define SENSOR_POWER_PIN 4

#define I2C_NODE DT_NODELABEL(i2c0)

static const struct device *gpio_dev;
static const struct device *i2c_dev;

void enable_si7021(void)
{
    gpio_dev = DEVICE_DT_GET(SENSOR_POWER_GPIO_NODE);
    if (!device_is_ready(gpio_dev)) {
        printk("Erro: GPIO não está pronto!\n");
        return;
    }

    gpio_pin_configure(gpio_dev, SENSOR_POWER_PIN, GPIO_OUTPUT);
    gpio_pin_set(gpio_dev, SENSOR_POWER_PIN, 1); // Liga o sensor
}

void main(void)
{
    printk("Inicializando Si7021...\n");

    enable_si7021();

    i2c_dev = DEVICE_DT_GET(I2C_NODE);
    if (!device_is_ready(i2c_dev)) {
        printk("Erro: I2C não está pronto!\n");
        return;
    }

    uint8_t cmd = 0xE3;  // Comando para medir temperatura (Hold Master Mode)
    uint8_t data[2];

    int ret = i2c_write_read(i2c_dev, 0x40, &cmd, 1, data, 2);
    if (ret < 0) {
        printk("Erro ao ler o Si7021!\n");
        return;
    }

    uint16_t raw_temp = (data[0] << 8) | data[1];
    float temp_c = ((175.72 * raw_temp) / 65536.0) - 46.85;

    printk("Temperatura: %.2f°C\n", temp_c);
}
```

## src/Icm2064@0.c
```c
#include <Icm2064@0.h>
#include <error.h>


static const struct device *dev = device_get_binding("Icm20648@0");

error_t init_icm2064(){

}

error_t read_icm2064(uint8_t *data, uint8_t len){

}

error_t getAceccelX(uint8_t *data){

}

error_t getAceccelY(uint8_t *data){

}

error_t getAceccelZ(uint8_t *data){

}

error_t getAceccel(sensor_data_t data){

}

error_t getGyroX(uint8_t *data){

}

error_t getGyroY(uint8_t *data){

}

error_t getGyroZ(uint8_t *data){

}

error_t getGyro(sensor_data_t data){

}
```

## src/Icm2064@0.h
```c
#include "zephyr/kernel.h"
#include "zephyr/drivers/gpio.h"
#include "zephyr/drivers/sensor/"
#include "zephyr/device.h"
#include "zephyr/types.h"

#define ICM2064_ADDR 0x0


typedef struct{
    uint8_t x;
    uint8_t y;
    uint8_t z;
} sensor_data_t;

/*  Inicializa o sensor */
error_t init_icm2064();

/*****************************************************/

//ACELEROMETO

/*  Pega o valor do vetor X do acelerometro, retorna um erro caso contrário*/
error_t getAceccelX(uint8_t *data);

/*  Pega o valor do vetor Y do acelerometro*, retorna um erro caso contrário/
error_t getAceccelY(uint8_t *data);

/*  Pega o valor do vetor Z do acelerometro, retorna um erro caso contrário*/
error_t getAceccelZ(uint8_t *data);

/*  Pega o um vetor do tipo [X, Y, Z] representando as coordenadas do acelerometro*/
error_t  getAceccel(sensor_data_t data);


/*****************************************************/

//GIROSCOPIO

/*  Pega o valor do vetor X do giroscopio, retorna um erro caso contrário*/
error_t getGyroX(uint_8 *data);

/*  Pega o valor do vetor Y do giroscopio, retorna um erro caso contrário*/
error_t getGyroY(uint_8 *data);

/*  Pega o valor do vetor Z do giroscopio, retorna um erro caso contrário*/
error_t getGyroZ(uint_8 *data);

/*  Pega o um vetor do tipo [X, Y, Z] representando as coordenadas do giroscopio*/
error_t  getGyro(sensor_data_t data);
```

## src/error.h
```c
#include "zephyr/types.h"

typedef uint8_t error_t;

#define ERROR_NONE 0x00
#define ERROR_GENERIC 0x01
#define ERROR_NOT_READY 0x02
#define ERROR_INVALID_PARAMETER 0x03
#define ERROR_NOT_SUPPORTED 0x04
#define ERROR_NOT_FOUND 0x05
#define ERROR_ALREADY_INITIALIZED 0x06
#define ERROR_NOT_INITIALIZED 0x07
#define ERRPR_UNVAIBLE 0x08
#define ERROR_INTERNAL 0x09
```

## src/ringbuf.c
```c
#include <zephyr/sys/ring_buffer.h>
#include <zephyr/kernel.h>
#include <zephyr/types.h>
#include <stdio.h>

//Criando e inicializando o ring_buffer
#define RING_BUF_SIZE 128
RING_BUF_DECLARE(ring_buf, RING_BUF_SIZE);

// inserir dados no ring buffer
void ring_buf_write(uint8_t *data, uint32_t size) {
    uint32_t bytes_written = ring_buf_put(&ring_buf, data, size);

    if (bytes_written != size) {
        printf("Falha ao inserir todos os dados no ring buffer.\n");
    } else {
        printf("Dados inseridos com sucesso no ring buffer.\n");
    }
}

// ler dados do ring buffer
void ring_buf_read(uint8_t *data, uint32_t size) {
    uint32_t bytes_read = ring_buf_get(&ring_buf, data, size);

    if (bytes_read == 0) {
        printf("Ring buffer está vazio.\n");
    } else {
        printf("Dados lidos do ring buffer: %d bytes\n", bytes_read);
    }
}


void main() {
    uint8_t write_data[] = "Teste de ring buffer";
    uint8_t read_data[sizeof(write_data)];

    ring_buf_write(write_data, sizeof(write_data)); //put
    uint32_t bytes_read = ring_buf_peek(&ring_buf,write_data, sizeof(read_data)); //peek
    ring_buf_read(read_data, sizeof(read_data)); //get

    ring_buf_reset(&ring_buf); // clear
    
    printf("Dados lidos: ");
    for (int i = 0; i < sizeof(read_data); i++) {
        printf("%c", read_data[i]);
    }
    printf("\n");
    printf("%d", bytes_read);

    return 0;
}
```
